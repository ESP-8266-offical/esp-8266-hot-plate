#include <ESP8266WiFi.h>
#include <AutoPID.h>
#include <MAX6675_Thermocouple.h>  
#include <DNSServer.h>
#include <ESP8266WebServer.h>
#include <ESP8266mDNS.h>
#include <WiFiUdp.h>
#include <ArduinoOTA.h>
#include <EEPROM.h>
#include <Arduino.h> 
#include <U8g2lib.h> 
#include "Ticker.h" //引入调度器头文件
#ifdef U8X8_HAVE_HW_I2C
#include <Wire.h> 
#endif

U8G2_SSD1306_128X64_NONAME_1_SW_I2C u8g2(U8G2_R0, /* clock=*/ SCL, /* data=*/ SDA, /* reset=*/ U8X8_PIN_NONE);   // All Boards without Reset of the Display 
#define SCK_PIN 14 
#define CS_PIN  15  
#define SO_PIN  12   
MAX6675_Thermocouple* thermocouple = NULL;
//pins
#define POT_PIN A0
#define OUTPUT_PIN 13
#define qx  16 
#define beep 2
#define vbus 0
#define TEMP_READ_DELAY 500 //can only read digital temp sensor every ~750ms

//pid settings and gains
#define OUTPUT_MIN 0
#define OUTPUT_MAX 1023
#define KP 0.57
#define KI 0.008 
#define KD 800


double temperature, setPoint, outputVal;
Ticker myTicker; //建立一个需要定时调度的对象
double sec1=0;
double min1=0;
void tickerHandle() //到时间时需要执行的任务
{
    
    sec1++;
    if(sec1==60){
      sec1=0;
      min1++;
    }
    //Serial.println(sec1); //打印当前时间
    //Serial.println(min1); //打印当前时间
    
}


//input/output variables passed by reference, so they are updated automatically
AutoPID myPID(&temperature, &setPoint, &outputVal, OUTPUT_MIN, OUTPUT_MAX, KP, KI, KD);

unsigned long lastTempUpdate; //tracks clock time of last temp update

//call repeatedly in loop, only updates after a certain time interval
//returns true if update happened
bool updateTemperature() {
  if ((millis() - lastTempUpdate) > TEMP_READ_DELAY) {
    temperature = thermocouple->readCelsius(); //get temp reading
    lastTempUpdate = millis();
    return true;
  }
  return false;
}//void updateTemperature
//
////////////////////////////////////////////////////////////////////////////配网+OTA
bool configure=0;
bool download=0;
const char* AP_NAME = "mini加热台配网";//wifi名字
//暂时存储wifi账号密码
char sta_ssid[32] = {0};
char sta_password[32] = {0};
//配网页面代码
const char* page_html = "\
<!DOCTYPE html>\r\n\
<html lang='en'>\r\n\
<head>\r\n\
  <meta charset='UTF-8'>\r\n\
  <meta name='viewport' content='width=device-width, initial-scale=1.0'>\r\n\
  <title>Document</title>\r\n\
</head>\r\n\
<body>\r\n\
  <form name='input' action='/' method='POST'>\r\n\
        mini加热台配网 <br>\r\n\
        wifi名称: <br>\r\n\
        <input type='text' name='ssid'><br>\r\n\
        wifi密码:<br>\r\n\
        <input type='text' name='password'><br>\r\n\
        <input type='submit' value='保存'><br>\r\n\
        blinker密钥:<br>\r\n\
        <input type='text' name='Key'><br>\r\n\
    </form>\r\n\
</body>\r\n\
</html>\r\n\
";

const byte DNS_PORT = 53;//DNS端口号
IPAddress apIP(192, 168, 4, 1);//esp8266-AP-IP地址
DNSServer dnsServer;//创建dnsServer实例
ESP8266WebServer server(80);//创建WebServer

//用EEPROM的a位保存字符串的长度，字符串的从EEPROM的b位开始保存，str为要保存的字符串
void set_String(int a,int b,String str){
  EEPROM.write(a, str.length());//EEPROM第a位，写入str字符串的长度
  //通过一个for循环，把str所有数据，逐个保存在EEPROM
  for (int i = 0; i < str.length(); i++){
    EEPROM.write(b + i, str[i]);
  }
  EEPROM.commit();//执行保存EEPROM
}

//获取指定EEPROM位置的字符串，a是字符串长度，b是起始位，从EEPROM的b位开始读取
String get_String(int a, int b){ 
  String data = "";
  //通过一个for循环，从EEPROM中逐个取出每一位的值，并连接起来
  for (int i = 0; i < a; i++){
    data += char(EEPROM.read(b + i));
  }
  return data;
}

void handleRoot() {//访问主页回调函数
  server.send(200, "text/html", page_html);
}

void handleRootPost() {//Post回调函数

  Serial.println("handleRootPost");
  if (server.hasArg("ssid")) {//判断是否有账号参数
    Serial.print("got ssid:");
    strcpy(sta_ssid, server.arg("ssid").c_str());//将账号参数拷贝到sta_ssid中
    Serial.println(sta_ssid);
    

    set_String(20,21,server.arg("ssid"));//保存wifi名称字符串长度到20位，21位开始保存字符串
    //Serial.println(server.arg("ssid").length());//打印wifi名称长度
    
  } else {//没有参数
    Serial.println("error, not found ssid");
    server.send(200, "text/html", "<meta charset='UTF-8'>error, not found ssid");//返回错误页面
    return;
  }
  //密码与账号同理
  if (server.hasArg("password")) {
    Serial.print("got password:");
    strcpy(sta_password, server.arg("password").c_str());
    Serial.println(sta_password);
    
    
    set_String(60,61,server.arg("password"));//保存wifi密码字符串长度到60位，61位开始保存字符串
    //Serial.println(server.arg("password").length());//打印wifi密码名称长度
    
    EEPROM.write(100, 1);                   //已配网标志
    EEPROM.commit();//执行保存EEPROM
    
  } else {
    Serial.println("error, not found password");
    server.send(200, "text/html", "<meta charset='UTF-8'>error, not found password");
    return;
  }

  server.send(200, "text/html", "<meta charset='UTF-8'>保存成功");//返回保存成功页面
  delay(2000);
  //连接wifi
  connectNewWifi();
  
}

void initBasic(void){//初始化基础
  
  WiFi.hostname("mini加热台");//设置ESP8266设备名
}

void initSoftAP(void){//初始化AP模式
  WiFi.mode(WIFI_AP);
  WiFi.softAPConfig(apIP, apIP, IPAddress(255, 255, 255, 0));
  if(WiFi.softAP(AP_NAME)){
    Serial.println("ESP8266 SoftAP is right");
  }
}

void initWebServer(void){//初始化WebServer
  //server.on("/",handleRoot);
  //上面那行必须以下面这种格式去写否则无法强制门户
  server.on("/", HTTP_GET, handleRoot);//设置主页回调函数
  server.onNotFound(handleRoot);//设置无法响应的http请求的回调函数
  server.on("/", HTTP_POST, handleRootPost);//设置Post请求回调函数
  server.begin();//启动WebServer
  Serial.println("WebServer started!");
}

void initDNS(void){//初始化DNS服务器
  if(dnsServer.start(DNS_PORT, "*", apIP)){//判断将所有地址映射到esp8266的ip上是否成功
    Serial.println("start dnsserver success.");
  }
  else Serial.println("start dnsserver failed.");
}

void connectNewWifi(void){
  WiFi.mode(WIFI_STA);//切换为STA模式
  WiFi.setAutoConnect(true);//设置自动连接
  WiFi.begin(sta_ssid,sta_password);//连接上一次连接成功的wifi
  
  Serial.println("");
  Serial.print("Connect to wifi");
  int count = 0;
  while (WiFi.status() != WL_CONNECTED) {
    delay(500);
    count++;
    if(count > 40){//如果5秒内没有连上，就开启Web配网 可适当调整这个时间
      
      initSoftAP();
      initWebServer();
      initDNS();
      configure=1;
      break;//跳出 防止无限初始化
    }
    Serial.print(".");
  }
  Serial.println("");
  if(WiFi.status() == WL_CONNECTED){//如果连接上 就输出IP信息 防止未连接上break后会误输出
    Serial.println("WIFI Connected!");
    Serial.print("IP address: ");
    Serial.println(WiFi.localIP());//打印esp8266的IP地址
    server.stop();
    
    WiFi.hostname("mini加热台");//设置ESP8266设备名
    ota();
    download=1;
  }
  
}


char p[5];

void ota(){
  
  Serial.begin(115200);
  Serial.println("Booting");

  ArduinoOTA.onStart([]() {
    u8g2.firstPage();
    do {
        u8g2.setFont(u8g2_font_ncenB08_tr); 
        u8g2.drawStr(5,20,"OTA Updating");
        
      } while ( u8g2.nextPage());
  });
  ArduinoOTA.onEnd([]() {
    u8g2.firstPage();
    do {
        u8g2.setFont(u8g2_font_ncenB12_tr); 
        u8g2.drawStr(20,40,"Restarting");
      } while ( u8g2.nextPage());
      
  });
  ArduinoOTA.onProgress([](unsigned int progress, unsigned int total) {
    u8g2.firstPage();
    do {
      u8g2.setFont(u8g2_font_ncenB08_tr); 
        u8g2.drawStr(25,20,"OTA Updating");
        u8g2.setFont(u8g2_font_ncenB12_tr); 
        sprintf(p, "%3d", (progress / (total / 100)));
        u8g2.drawStr(40,45,p); 
        u8g2.drawStr(70,45,"%"); 
      } while ( u8g2.nextPage()); 
    Serial.printf("Progress: %u%%\r", (progress / (total / 100)));
  });
  ArduinoOTA.onError([](ota_error_t error) {
    Serial.printf("Error[%u]: ", error);
    if (error == OTA_AUTH_ERROR) {
      Serial.println("Auth Failed");
    } else if (error == OTA_BEGIN_ERROR) {
      Serial.println("Begin Failed");
    } else if (error == OTA_CONNECT_ERROR) {
      Serial.println("Connect Failed");
    } else if (error == OTA_RECEIVE_ERROR) {
      Serial.println("Receive Failed");
    } else if (error == OTA_END_ERROR) {
      Serial.println("End Failed");
    }
  });
  ArduinoOTA.begin();
  Serial.println("Ready");
  Serial.print("IP address: ");
  Serial.println(WiFi.localIP());
  
}

/////////////////////////////////////////////////////////////////////////////////////////////////////////

static const unsigned char bitmap1[] U8X8_PROGMEM = {
  0x00,0x00,0x00,0x00,0x00,0x00,0x00,0x00,0x00,0x00,0x00,0x00,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0x00,
 };//显示符号“℃” 


 static const unsigned char bitmap7[] U8X8_PROGMEM = {
0x00,0x00,0x00,0x00,0x00,0x00,0x00,0x00,0x00,0x00,0x00,0x00,0x00,0x00,0x00,0x00,
0x00,0x00,0x00,0x00,0x00,0x00,0x00,0x00,0x00,0x00,0x00,0x00,0x00,0x00,0x00,0x00,
0x00,0x00,0x00,0x00,0x00,0x00,0x00,0x00,0x00,0x00,0x00,0x00,0x00,0x00,0x00,0x00,
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0x00,0x00,0x00,0x00,0x00,0x00,0x00,0x00,0x00,0x00,0x00,0x00,0x00,0x00,0x00,0x00,
};//请断电重启

 static const unsigned char off[] U8X8_PROGMEM = {
0x00,0x00,0x00,0x00,0x00,0x00,0x00,0x00,0x00,0x00,0x00,0x00,0x00,0x00,0x00,0x00,
0x00,0x00,0x00,0x00,0x00,0x00,0x00,0x00,0x00,0x00,0x00,0x00,0x00,0x00,0x00,0x00,
0x00,0x00,0x00,0x00,0xF0,0x0F,0x00,0x00,0x00,0x00,0x00,0x00,0x00,0x00,0x00,0x00,
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0x00,0x00,0x00,0x00,0xF0,0x0F,0x00,0x00,0x00,0x00,0x00,0x00,0x00,0x00,0x00,0x00,
};//off
 static const unsigned char on[] U8X8_PROGMEM = {  
0x00,0x00,0x00,0x00,0x00,0x00,0x00,0x00,0x00,0x00,0x00,0x00,0x00,0x00,0x00,0x00,
0x00,0x00,0x00,0x00,0x00,0x00,0x00,0x00,0x00,0x00,0x00,0x00,0x00,0x00,0x00,0x00,
0x00,0x00,0x00,0x00,0x00,0x00,0x00,0x00,0x00,0x00,0x00,0x00,0x00,0x00,0x00,0x00,
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0x00,0x00,0xFC,0x07,0x00,0x08,0x00,0x00,0x00,0x00,0x03,0x00,0x00,0x80,0x1F,0x00,
0x00,0x00,0x00,0x00,0x00,0x00,0x00,0x00,0x00,0x00,0x00,0x00,0x00,0x80,0x03,0x00,+
0x00,0x00,0x00,0x00,0x00,0x00,0x00,0x00,0x00,0x00,0x00,0x00,0x00,0x00,0x00,0x00,
0x00,0x00,0x00,0x00,0x00,0x00,0x00,0x00,0x00,0x00,0x00,0x00,0x00,0x00,0x00,0x00,
0x00,0x00,0x00,0x00,0x00,0x00,0x00,0x00,0x00,0x00,0x00,0x00,0x00,0x00,0x00,0x00,
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0x00,0x00,0x00,0x00,0x00,0x00,0x00,0x00,0x00,0x00,0x00,0x00,0x00,0x00,0x00,0x00,
};//请拨动开机
 static const unsigned char yjsl[] U8X8_PROGMEM = {
0x00,0x00,0x00,0x00,0x00,0x00,0x00,0x00,0x00,0x00,0x00,0x00,0x00,0x00,0x00,0x00,0x00,0x00,0x00,0x00,0x00,0x00,0x00,0x00,0x00,0x00,0x00,0x00,0x00,0x00,0x00,0x00,
0x00,0x00,0x00,0x00,0x00,0x00,0x00,0x00,0x00,0x00,0x00,0x00,0x00,0x00,0x00,0x00,0x00,0x00,0x00,0x00,0x00,0x00,0x00,0x00,0x00,0x00,0x00,0x00,0x00,0x00,0x00,0x00,
0x00,0x00,0x00,0x00,0x00,0x00,0x00,0x00,0x00,0x00,0x00,0x00,0x00,0x00,0x00,0x00,0x00,0x00,0x00,0x00,0x00,0x00,0x00,0x00,0x00,0x00,0x00,0x00,0x00,0x00,0x00,0x00,
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0x00,0x00,0x00,0x00,0x00,0x00,0x00,0x00,0x00,0x00,0x00,0x00,0x00,0x00,0x00,0x00,0x00,0x00,0x00,0x00,0x00,0x00,0x00,0x00,0x00,0x00,0x00,0x00,0x00,0x00,0x00,0x00,
};//一键三连

double set0;
double set1;
void setup() {
  
   pinMode(beep, OUTPUT);
  analogWrite(beep, 1000);
  delay(500);// 延时300ms
  digitalWrite(beep, 1);
  pinMode(vbus, INPUT);
  pinMode(POT_PIN, INPUT);
  pinMode(qx, INPUT_PULLUP);
  pinMode(OUTPUT_PIN, OUTPUT);
  analogWriteFreq(20000); //设置PWM频率为20k

  Serial.begin(115200); //   
  ESP.wdtEnable(500);//看门狗定时器5000ms超时
  EEPROM.begin(512);
  thermocouple = new MAX6675_Thermocouple(SCK_PIN, CS_PIN, SO_PIN);
  u8g2.begin();   
  u8g2.enableUTF8Print();    // enable UTF8 support for the Arduino print() function  

  //if temperature is more than 4 degrees below or above setpoint, OUTPUT will be set to min or max respectively
  myPID.setBangBang(20);
  //set PID update interval to 4000ms
  myPID.setTimeStep(200);
  //读取内存的WiFi信息
   if(EEPROM.read(100)==1){

    strcpy(sta_ssid,get_String(EEPROM.read(20), 21).c_str());
    strcpy(sta_password,get_String(EEPROM.read(60), 61).c_str());
    Serial.println(sta_ssid);
    Serial.println(sta_password);

  }
  myTicker.attach(1, tickerHandle); //初始化调度任务，每1秒执行一次tickerHandle()
  while(set1<10&set1>-10&sec1<30)//拨动开机
  {
    Serial.println(sec1);
    set0=analogRead(POT_PIN);
    delay(100);
    set1=analogRead(POT_PIN)-set0;
    digitalWrite(OUTPUT_PIN, 0);
    u8g2.firstPage();
    do {
      u8g2.drawXBMP(0, 4, 128, 60, on);
    } while (u8g2.nextPage());  
  }
  if(sec1>=30)
  {
    //配网
    u8g2.firstPage();
    do {
      u8g2.setFont(u8g2_font_ncenB08_tr); 
      u8g2.drawStr(0,30,"Connecting..."); 
    } while ( u8g2.nextPage());
    initBasic();
    connectNewWifi();
    Serial.println("配网");
  }
  
  
}

char t[5];
char set[5];
char csec[5];
char cmin[5];
int qxflag=0;
int beepflag=0;
void bilibili()
{
  u8g2.firstPage();
  do {
    u8g2.drawXBMP(0, 4, 128, 60, yjsl);
  } while (u8g2.nextPage()); 
}
void run()
{
  double celsius = thermocouple->readCelsius(); // 摄氏度
  //Serial.println(celsius);  // println打印会自动添加'\r\n'，可以在串口绘图器显示
 
  if(digitalRead(qx)==0&qxflag==0){ 
   
  updateTemperature();
  delay(100);// 延时100ms
  
  set1=analogRead(POT_PIN)-set0;
  if(set1<-10|set1>10){
    beepflag=0;
  }
  setPoint = analogRead(POT_PIN)/4;
  Serial.println(analogRead(POT_PIN)/4);
  myPID.run(); //call every loop, updates automatically at certain time interval
  //analogWriteFreq(200);
  outputVal=outputVal*100;
  if(digitalRead(vbus)==0){
    analogWrite(OUTPUT_PIN,0);
  }
  else{
    analogWrite(OUTPUT_PIN, outputVal); 
  }
  if(myPID.atSetPoint(0.5)==1&beepflag==0){
    beepflag=1;
    set0=analogRead(POT_PIN);
    analogWriteFreq(1000); //设置PWM频率为1k
    analogWrite(beep, 800);
    delay(200);
    analogWrite(beep, 1024);
    delay(100);
    analogWrite(beep, 800);
    delay(200);
    analogWrite(beep, 1024);
    analogWriteFreq(20000); //设置PWM频率为20k
  }
  
  //Serial.println(outputVal);
  //digitalWrite(beep, myPID.atSetPoint(1)); //light up LED when we're at setpoint +-1 degree
  u8g2.firstPage();
  do {
    u8g2.setFont(u8g2_font_ncenB10_tr);
    sprintf(t, "%3.2lf", temperature);
    u8g2.drawStr(0,64,t);                //当前温度
    if(digitalRead(vbus)==0){
      u8g2.drawStr(55,64,"5V");
    }
    else{
      u8g2.drawStr(55,64,"20V");
    }
    u8g2.setFont(u8g2_font_logisoso42_tn);
    if(setPoint<=2)
    {
      u8g2.drawXBMP(0, 4, 128, 40, off);
      sec1=0;
      min1=0;
    }
    else
    {
    sprintf(set, "%3.lf", setPoint);
    u8g2.drawStr(5,48,set);                //设定温度
    u8g2.drawXBMP(92, 6, 35, 42, bitmap1); //℃

    u8g2.setFont(u8g2_font_ncenB10_tr);
    sprintf(cmin, "%02.lf", min1);                 //分
    u8g2.drawStr(87,64,cmin);
    u8g2.drawStr(104,64,":");
    sprintf(csec, "%02.lf", sec1);                 //秒
    u8g2.drawStr(110,64,csec);  
                  
    }
   
  } while ( u8g2.nextPage() );
  
  }
  else{
    qxflag=1;
    analogWrite(OUTPUT_PIN, 0);
    u8g2.firstPage();
    do {
      u8g2.drawXBMP(0, 15, 128, 40, bitmap7);
    } while (u8g2.nextPage()); 
    Serial.println(analogRead(POT_PIN));
    if(analogRead(POT_PIN)<=5){       ESP.restart(); //ESP.reset(); 
    }
  }
}
void loop() 
{
   ESP.wdtFeed();
   if(configure==1&download==0){      //////////////////////配网
    //Serial.println("配网");
    u8g2.firstPage();
    do {
      u8g2.setFont(u8g2_font_ncenB08_tr); 
      u8g2.drawStr(5,15,"Configure");
      u8g2.drawStr(30,32,"wifi"); 
      
      server.handleClient();
      dnsServer.processNextRequest();
      
    } while ( u8g2.nextPage());
    
  }
  else if(download==1){ ///////////////////////OTA
    //Serial.println("OTA");
    u8g2.firstPage();
    do {
      u8g2.setFont(u8g2_font_ncenB08_tr); 
      u8g2.drawStr(0,20,"Connected to");
      u8g2.drawStr(0,40,sta_ssid); 
      
      ArduinoOTA.handle();
      
    } while ( u8g2.nextPage());    
    ArduinoOTA.handle();
  }
  else{                                                        //正常运行
    run();
    //bilibili();
 }
}
